#include <SPI.h>

// PIN 8 LED
// PIN 7 serial clock
// PIN 6 MOSI 
// PIN 5 D/C data/command
// PIN 4 RST reset?
// PIN 3 Slave Select
// PIN 2 ground 
// PIN 1 voltage 3.3

#define OUT_RST 6
#define OUT_LED 2
#define OUT_DC 5
#define OUT_SCE 10 // 4, 10, 52

#define WIDTH 84
#define HEIGHT 48
#define BANKS 504
#define PIXELS 4032

byte pixelBuffer[BANKS]; 

void initialize() {
    Serial.begin(9600);
    pinMode(OUT_LED, OUTPUT);
    pinMode(OUT_RST, OUTPUT);
    pinMode(OUT_DC, OUTPUT);

    digitalWrite(OUT_LED, 0); // turn LED off

    resetDisplay();

    SPI.begin(OUT_SCE);
    SPI.setClockDivider(OUT_SCE, 84);
    delay(100); 

    commandMode();
    delay(100);
    sendByte(0x21); // FUNCTION SET
    sendByte(0x14); // SET BIAS
    sendByte(0b10110000); // SET CONTRAST
    sendByte(0x20); // FUNCTION SET
    sendByte(0x0C); // SET DISPLAY MODE
    dataMode();
    delay(100);
    digitalWrite(OUT_LED, HIGH);
}

void resetDisplay() {
    digitalWrite(OUT_RST, LOW);
    delay(500);
    digitalWrite(OUT_RST, HIGH);
}

void commandMode() {
    digitalWrite(OUT_DC, LOW);
}

void dataMode() {
    digitalWrite(OUT_DC, HIGH);
}

void setup()
{
    initialize();
}

int column = 0;
int row = 0;
bool add = 1;

void loop()
{
//    if (row > 5) {
//        row = 0;
//        clearDisplay();
//    } else {
//        for (int i = 0; i<8; i++){
//            setPixel(column, row*8+i, true);
//        }
//        ++column;
//        if (column > 83) {
//            column = 0;
//            ++row;
//        }
//    }

    if (column > 83) {
        column = 0;
        add = !add;
    } else {
        for (int i = 0; i<83; i++){
            if (add) {
                setPixel(column, i, true);
            } else {
                setPixel(column, i, false);
            }
        }
        ++column;
    }

    drawBuffer();
    delay(20);
}

void drawBuffer() {
    for(int i = 0; i < BANKS; ++i) {
        sendByte(pixelBuffer[i]);
    }    
}

void sendByte(byte data) {
    SPI.transfer(OUT_SCE, data);
}

void clearDisplay() {
    for(int i = 0; i < BANKS; ++i) {
        pixelBuffer[i] = 0x00;
    }
}

void makeBlack(){
    for(int i = 0; i < BANKS; ++i) {
        pixelBuffer[i] = 0xFF;
    }
}


void setPixel(int x, int y, bool value) {
    if(x < 0 || x >= WIDTH || y < 0 || y >= HEIGHT) return;

    int row = y / 8;
    int index = row * WIDTH + x;
    int bankIndex = y % 8;
    int bitmask = 1 << bankIndex;

    if(value) {
        pixelBuffer[index] |= bitmask;
    } else {
        pixelBuffer[index] &= ~bitmask;
    }
}

unsigned char font[95][6] =
{
    { 0x00, 0x00, 0x00, 0x00, 0x00, 0x00 }, // space
    { 0x00, 0x00, 0x5F, 0x00, 0x00, 0x00 }, // !
    { 0x00, 0x07, 0x00, 0x07, 0x00, 0x00 }, // "
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    { 0x10, 0x08, 0x08, 0x10, 0x08, 0x00 } // ~
};
